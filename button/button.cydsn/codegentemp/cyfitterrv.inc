    IF :LNOT::DEF:INCLUDED_CYFITTERRV_INC
INCLUDED_CYFITTERRV_INC EQU 1
    GET cydevicerv.inc
    GET cydevicerv_trm.inc

; LCD_LCDPort
LCD_LCDPort__0__MASK EQU 0x01
LCD_LCDPort__0__PC EQU CYREG_PRT2_PC0
LCD_LCDPort__0__PORT EQU 2
LCD_LCDPort__0__SHIFT EQU 0
LCD_LCDPort__1__MASK EQU 0x02
LCD_LCDPort__1__PC EQU CYREG_PRT2_PC1
LCD_LCDPort__1__PORT EQU 2
LCD_LCDPort__1__SHIFT EQU 1
LCD_LCDPort__2__MASK EQU 0x04
LCD_LCDPort__2__PC EQU CYREG_PRT2_PC2
LCD_LCDPort__2__PORT EQU 2
LCD_LCDPort__2__SHIFT EQU 2
LCD_LCDPort__3__MASK EQU 0x08
LCD_LCDPort__3__PC EQU CYREG_PRT2_PC3
LCD_LCDPort__3__PORT EQU 2
LCD_LCDPort__3__SHIFT EQU 3
LCD_LCDPort__4__MASK EQU 0x10
LCD_LCDPort__4__PC EQU CYREG_PRT2_PC4
LCD_LCDPort__4__PORT EQU 2
LCD_LCDPort__4__SHIFT EQU 4
LCD_LCDPort__5__MASK EQU 0x20
LCD_LCDPort__5__PC EQU CYREG_PRT2_PC5
LCD_LCDPort__5__PORT EQU 2
LCD_LCDPort__5__SHIFT EQU 5
LCD_LCDPort__6__MASK EQU 0x40
LCD_LCDPort__6__PC EQU CYREG_PRT2_PC6
LCD_LCDPort__6__PORT EQU 2
LCD_LCDPort__6__SHIFT EQU 6
LCD_LCDPort__AG EQU CYREG_PRT2_AG
LCD_LCDPort__AMUX EQU CYREG_PRT2_AMUX
LCD_LCDPort__BIE EQU CYREG_PRT2_BIE
LCD_LCDPort__BIT_MASK EQU CYREG_PRT2_BIT_MASK
LCD_LCDPort__BYP EQU CYREG_PRT2_BYP
LCD_LCDPort__CTL EQU CYREG_PRT2_CTL
LCD_LCDPort__DM0 EQU CYREG_PRT2_DM0
LCD_LCDPort__DM1 EQU CYREG_PRT2_DM1
LCD_LCDPort__DM2 EQU CYREG_PRT2_DM2
LCD_LCDPort__DR EQU CYREG_PRT2_DR
LCD_LCDPort__INP_DIS EQU CYREG_PRT2_INP_DIS
LCD_LCDPort__LCD_COM_SEG EQU CYREG_PRT2_LCD_COM_SEG
LCD_LCDPort__LCD_EN EQU CYREG_PRT2_LCD_EN
LCD_LCDPort__MASK EQU 0x7F
LCD_LCDPort__PORT EQU 2
LCD_LCDPort__PRT EQU CYREG_PRT2_PRT
LCD_LCDPort__PRTDSI__CAPS_SEL EQU CYREG_PRT2_CAPS_SEL
LCD_LCDPort__PRTDSI__DBL_SYNC_IN EQU CYREG_PRT2_DBL_SYNC_IN
LCD_LCDPort__PRTDSI__OE_SEL0 EQU CYREG_PRT2_OE_SEL0
LCD_LCDPort__PRTDSI__OE_SEL1 EQU CYREG_PRT2_OE_SEL1
LCD_LCDPort__PRTDSI__OUT_SEL0 EQU CYREG_PRT2_OUT_SEL0
LCD_LCDPort__PRTDSI__OUT_SEL1 EQU CYREG_PRT2_OUT_SEL1
LCD_LCDPort__PRTDSI__SYNC_OUT EQU CYREG_PRT2_SYNC_OUT
LCD_LCDPort__PS EQU CYREG_PRT2_PS
LCD_LCDPort__SHIFT EQU 0
LCD_LCDPort__SLW EQU CYREG_PRT2_SLW

; button1
button1__0__MASK EQU 0x02
button1__0__PC EQU CYREG_PRT6_PC1
button1__0__PORT EQU 6
button1__0__SHIFT EQU 1
button1__AG EQU CYREG_PRT6_AG
button1__AMUX EQU CYREG_PRT6_AMUX
button1__BIE EQU CYREG_PRT6_BIE
button1__BIT_MASK EQU CYREG_PRT6_BIT_MASK
button1__BYP EQU CYREG_PRT6_BYP
button1__CTL EQU CYREG_PRT6_CTL
button1__DM0 EQU CYREG_PRT6_DM0
button1__DM1 EQU CYREG_PRT6_DM1
button1__DM2 EQU CYREG_PRT6_DM2
button1__DR EQU CYREG_PRT6_DR
button1__INP_DIS EQU CYREG_PRT6_INP_DIS
button1__LCD_COM_SEG EQU CYREG_PRT6_LCD_COM_SEG
button1__LCD_EN EQU CYREG_PRT6_LCD_EN
button1__MASK EQU 0x02
button1__PORT EQU 6
button1__PRT EQU CYREG_PRT6_PRT
button1__PRTDSI__CAPS_SEL EQU CYREG_PRT6_CAPS_SEL
button1__PRTDSI__DBL_SYNC_IN EQU CYREG_PRT6_DBL_SYNC_IN
button1__PRTDSI__OE_SEL0 EQU CYREG_PRT6_OE_SEL0
button1__PRTDSI__OE_SEL1 EQU CYREG_PRT6_OE_SEL1
button1__PRTDSI__OUT_SEL0 EQU CYREG_PRT6_OUT_SEL0
button1__PRTDSI__OUT_SEL1 EQU CYREG_PRT6_OUT_SEL1
button1__PRTDSI__SYNC_OUT EQU CYREG_PRT6_SYNC_OUT
button1__PS EQU CYREG_PRT6_PS
button1__SHIFT EQU 1
button1__SLW EQU CYREG_PRT6_SLW

; button2
button2__0__MASK EQU 0x20
button2__0__PC EQU CYREG_IO_PC_PRT15_PC5
button2__0__PORT EQU 15
button2__0__SHIFT EQU 5
button2__AG EQU CYREG_PRT15_AG
button2__AMUX EQU CYREG_PRT15_AMUX
button2__BIE EQU CYREG_PRT15_BIE
button2__BIT_MASK EQU CYREG_PRT15_BIT_MASK
button2__BYP EQU CYREG_PRT15_BYP
button2__CTL EQU CYREG_PRT15_CTL
button2__DM0 EQU CYREG_PRT15_DM0
button2__DM1 EQU CYREG_PRT15_DM1
button2__DM2 EQU CYREG_PRT15_DM2
button2__DR EQU CYREG_PRT15_DR
button2__INP_DIS EQU CYREG_PRT15_INP_DIS
button2__LCD_COM_SEG EQU CYREG_PRT15_LCD_COM_SEG
button2__LCD_EN EQU CYREG_PRT15_LCD_EN
button2__MASK EQU 0x20
button2__PORT EQU 15
button2__PRT EQU CYREG_PRT15_PRT
button2__PRTDSI__CAPS_SEL EQU CYREG_PRT15_CAPS_SEL
button2__PRTDSI__DBL_SYNC_IN EQU CYREG_PRT15_DBL_SYNC_IN
button2__PRTDSI__OE_SEL0 EQU CYREG_PRT15_OE_SEL0
button2__PRTDSI__OE_SEL1 EQU CYREG_PRT15_OE_SEL1
button2__PRTDSI__OUT_SEL0 EQU CYREG_PRT15_OUT_SEL0
button2__PRTDSI__OUT_SEL1 EQU CYREG_PRT15_OUT_SEL1
button2__PRTDSI__SYNC_OUT EQU CYREG_PRT15_SYNC_OUT
button2__PS EQU CYREG_PRT15_PS
button2__SHIFT EQU 5
button2__SLW EQU CYREG_PRT15_SLW

; led1
led1__0__MASK EQU 0x01
led1__0__PC EQU CYREG_PRT6_PC0
led1__0__PORT EQU 6
led1__0__SHIFT EQU 0
led1__AG EQU CYREG_PRT6_AG
led1__AMUX EQU CYREG_PRT6_AMUX
led1__BIE EQU CYREG_PRT6_BIE
led1__BIT_MASK EQU CYREG_PRT6_BIT_MASK
led1__BYP EQU CYREG_PRT6_BYP
led1__CTL EQU CYREG_PRT6_CTL
led1__DM0 EQU CYREG_PRT6_DM0
led1__DM1 EQU CYREG_PRT6_DM1
led1__DM2 EQU CYREG_PRT6_DM2
led1__DR EQU CYREG_PRT6_DR
led1__INP_DIS EQU CYREG_PRT6_INP_DIS
led1__LCD_COM_SEG EQU CYREG_PRT6_LCD_COM_SEG
led1__LCD_EN EQU CYREG_PRT6_LCD_EN
led1__MASK EQU 0x01
led1__PORT EQU 6
led1__PRT EQU CYREG_PRT6_PRT
led1__PRTDSI__CAPS_SEL EQU CYREG_PRT6_CAPS_SEL
led1__PRTDSI__DBL_SYNC_IN EQU CYREG_PRT6_DBL_SYNC_IN
led1__PRTDSI__OE_SEL0 EQU CYREG_PRT6_OE_SEL0
led1__PRTDSI__OE_SEL1 EQU CYREG_PRT6_OE_SEL1
led1__PRTDSI__OUT_SEL0 EQU CYREG_PRT6_OUT_SEL0
led1__PRTDSI__OUT_SEL1 EQU CYREG_PRT6_OUT_SEL1
led1__PRTDSI__SYNC_OUT EQU CYREG_PRT6_SYNC_OUT
led1__PS EQU CYREG_PRT6_PS
led1__SHIFT EQU 0
led1__SLW EQU CYREG_PRT6_SLW

; led2
led2__0__MASK EQU 0x40
led2__0__PC EQU CYREG_PRT6_PC6
led2__0__PORT EQU 6
led2__0__SHIFT EQU 6
led2__AG EQU CYREG_PRT6_AG
led2__AMUX EQU CYREG_PRT6_AMUX
led2__BIE EQU CYREG_PRT6_BIE
led2__BIT_MASK EQU CYREG_PRT6_BIT_MASK
led2__BYP EQU CYREG_PRT6_BYP
led2__CTL EQU CYREG_PRT6_CTL
led2__DM0 EQU CYREG_PRT6_DM0
led2__DM1 EQU CYREG_PRT6_DM1
led2__DM2 EQU CYREG_PRT6_DM2
led2__DR EQU CYREG_PRT6_DR
led2__INP_DIS EQU CYREG_PRT6_INP_DIS
led2__LCD_COM_SEG EQU CYREG_PRT6_LCD_COM_SEG
led2__LCD_EN EQU CYREG_PRT6_LCD_EN
led2__MASK EQU 0x40
led2__PORT EQU 6
led2__PRT EQU CYREG_PRT6_PRT
led2__PRTDSI__CAPS_SEL EQU CYREG_PRT6_CAPS_SEL
led2__PRTDSI__DBL_SYNC_IN EQU CYREG_PRT6_DBL_SYNC_IN
led2__PRTDSI__OE_SEL0 EQU CYREG_PRT6_OE_SEL0
led2__PRTDSI__OE_SEL1 EQU CYREG_PRT6_OE_SEL1
led2__PRTDSI__OUT_SEL0 EQU CYREG_PRT6_OUT_SEL0
led2__PRTDSI__OUT_SEL1 EQU CYREG_PRT6_OUT_SEL1
led2__PRTDSI__SYNC_OUT EQU CYREG_PRT6_SYNC_OUT
led2__PS EQU CYREG_PRT6_PS
led2__SHIFT EQU 6
led2__SLW EQU CYREG_PRT6_SLW

; Miscellaneous
; -- WARNING: define names containing LEOPARD or PANTHER are deprecated and will be removed in a future release
CYDEV_DEBUGGING_DPS_SWD_SWV EQU 6
CYDEV_CONFIG_UNUSED_IO_AllowButWarn EQU 0
CYDEV_CONFIGURATION_MODE_COMPRESSED EQU 0
CYDEV_CONFIG_FASTBOOT_ENABLED EQU 1
CYDEV_CHIP_REV_PSOC5LP_PRODUCTION EQU 0
CYDEV_CHIP_REVISION_5B_PRODUCTION EQU 0
CYDEV_CHIP_MEMBER_5B EQU 3
CYDEV_CHIP_FAMILY_PSOC5 EQU 3
CYDEV_CHIP_DIE_PSOC5LP EQU 3
CYDEV_CHIP_DIE_EXPECT EQU CYDEV_CHIP_DIE_PSOC5LP
BCLK__BUS_CLK__HZ EQU 24000000
BCLK__BUS_CLK__KHZ EQU 24000
BCLK__BUS_CLK__MHZ EQU 24
CYDEV_CHIP_DIE_ACTUAL EQU CYDEV_CHIP_DIE_EXPECT
CYDEV_CHIP_DIE_LEOPARD EQU 1
CYDEV_CHIP_DIE_PANTHER EQU 2
CYDEV_CHIP_DIE_UNKNOWN EQU 0
CYDEV_CHIP_FAMILY_PSOC3 EQU 1
CYDEV_CHIP_FAMILY_PSOC4 EQU 2
CYDEV_CHIP_FAMILY_UNKNOWN EQU 0
CYDEV_CHIP_FAMILY_USED EQU CYDEV_CHIP_FAMILY_PSOC5
CYDEV_CHIP_JTAG_ID EQU 0x2E123069
CYDEV_CHIP_MEMBER_3A EQU 1
CYDEV_CHIP_MEMBER_5A EQU 2
CYDEV_CHIP_MEMBER_UNKNOWN EQU 0
CYDEV_CHIP_MEMBER_USED EQU CYDEV_CHIP_MEMBER_5B
CYDEV_CHIP_REVISION_3A_ES1 EQU 0
CYDEV_CHIP_REVISION_3A_ES2 EQU 1
CYDEV_CHIP_REVISION_3A_ES3 EQU 3
CYDEV_CHIP_REVISION_3A_PRODUCTION EQU 3
CYDEV_CHIP_REVISION_5A_ES0 EQU 0
CYDEV_CHIP_REVISION_5A_ES1 EQU 1
CYDEV_CHIP_REVISION_5A_PRODUCTION EQU 1
CYDEV_CHIP_REVISION_5B_ES EQU 0
CYDEV_CHIP_REVISION_USED EQU CYDEV_CHIP_REVISION_5B_PRODUCTION
CYDEV_CHIP_REV_EXPECT EQU CYDEV_CHIP_REV_PSOC5LP_PRODUCTION
CYDEV_CHIP_REV_LEOPARD_ES1 EQU 0
CYDEV_CHIP_REV_LEOPARD_ES2 EQU 1
CYDEV_CHIP_REV_LEOPARD_ES3 EQU 3
CYDEV_CHIP_REV_LEOPARD_PRODUCTION EQU 3
CYDEV_CHIP_REV_PANTHER_ES0 EQU 0
CYDEV_CHIP_REV_PANTHER_ES1 EQU 1
CYDEV_CHIP_REV_PANTHER_PRODUCTION EQU 1
CYDEV_CHIP_REV_PSOC5LP_ES EQU 0
CYDEV_CONFIGURATION_COMPRESSED EQU 1
CYDEV_CONFIGURATION_DMA EQU 0
CYDEV_CONFIGURATION_ECC EQU 1
CYDEV_CONFIGURATION_IMOENABLED EQU CYDEV_CONFIG_FASTBOOT_ENABLED
CYDEV_CONFIGURATION_MODE EQU CYDEV_CONFIGURATION_MODE_COMPRESSED
CYDEV_CONFIGURATION_MODE_DMA EQU 2
CYDEV_CONFIGURATION_MODE_UNCOMPRESSED EQU 1
CYDEV_CONFIG_FORCE_ROUTE EQU 0
CYDEV_CONFIG_UNUSED_IO EQU CYDEV_CONFIG_UNUSED_IO_AllowButWarn
CYDEV_CONFIG_UNUSED_IO_AllowWithInfo EQU 1
CYDEV_CONFIG_UNUSED_IO_Disallowed EQU 2
CYDEV_DEBUGGING_DPS EQU CYDEV_DEBUGGING_DPS_SWD_SWV
CYDEV_DEBUGGING_DPS_Disable EQU 3
CYDEV_DEBUGGING_DPS_JTAG_4 EQU 1
CYDEV_DEBUGGING_DPS_JTAG_5 EQU 0
CYDEV_DEBUGGING_DPS_SWD EQU 2
CYDEV_DEBUGGING_ENABLE EQU 1
CYDEV_DEBUGGING_REQXRES EQU 1
CYDEV_DEBUGGING_XRES EQU 0
CYDEV_DEBUG_ENABLE_MASK EQU 0x20
CYDEV_DEBUG_ENABLE_REGISTER EQU CYREG_MLOGIC_DEBUG
CYDEV_DMA_CHANNELS_AVAILABLE EQU 24
CYDEV_ECC_ENABLE EQU 0
CYDEV_HEAP_SIZE EQU 0x1000
CYDEV_INSTRUCT_CACHE_ENABLED EQU 1
CYDEV_PROJ_TYPE EQU 0
CYDEV_PROJ_TYPE_BOOTLOADER EQU 1
CYDEV_PROJ_TYPE_LOADABLE EQU 2
CYDEV_PROJ_TYPE_MULTIAPPBOOTLOADER EQU 3
CYDEV_PROJ_TYPE_STANDARD EQU 0
CYDEV_PROTECTION_ENABLE EQU 0
CYDEV_STACK_SIZE EQU 0x4000
CYDEV_VDDA_MV EQU 5000
CYDEV_VDDD_MV EQU 5000
CYDEV_VDDIO0_MV EQU 5000
CYDEV_VDDIO1_MV EQU 5000
CYDEV_VDDIO2_MV EQU 5000
CYDEV_VDDIO3_MV EQU 5000
CYDEV_VIO0 EQU 5
CYDEV_VIO0_MV EQU 5000
CYDEV_VIO1 EQU 5
CYDEV_VIO1_MV EQU 5000
CYDEV_VIO2 EQU 5
CYDEV_VIO2_MV EQU 5000
CYDEV_VIO3 EQU 5
CYDEV_VIO3_MV EQU 5000
DMA_CHANNELS_USED__MASK0 EQU 0x00000000
CYDEV_BOOTLOADER_ENABLE EQU 0
    ENDIF
    END
